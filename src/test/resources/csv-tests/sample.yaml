## src/test/resources/csv-tests/sample.yaml
```yaml
---
name: CSV Example
description: CSV and other delimited data
queries:
   - name: StringTest
     engine: csv
     value: |
            A,B,C
            foo,234.3,bar
            baz,9,qux
            foo,42,norf
     metadata:
         - key: B
           value: DOUBLE
   - name: FileLoadingTest
     engine: csv
     value: "src/test/resources/csv-tests/file.csv"
     metadata:
         - key: fieldB
           value: LONG
         - key: fieldC
           value: DECIMAL
   - name: CustomDelimASCII
     engine: csv
     value: |
            A;B;C
            foo;234.3;bar
            baz;9;qux
            foo;42;norf
     metadata:
         - key: delimiter
           value: ";"
   - name: CustomDelimUnicode
     engine: csv
     value: |
            A\u0001B\u0001C
            foo\u0001234.3\u0001bar
            baz\u00019\u0001qux
            foo\u000142\u0001norf
     metadata:
         - key: delimiter
           value: "\u0001"
tests:
   - name: Testing something
     description: Why I am testing this.
     asserts:
...
```

## src/test/resources/pig-tests/sample.yaml
```yaml
---
name: Pig test
description: Testing Validatar
queries:
   - name: Query
     engine: pig
     value: "a = LOAD 'src/test/resources/pig-tests/data.txt' USING PigStorage(',') AS (name:chararray, count:long);
             b = GROUP a BY name;
             c = FOREACH b GENERATE
                           group AS name,
                           SUM(a.count) AS total;
             d = ORDER c BY total DESC;
             e = LIMIT d 1;"
     metadata:
         - key: output-alias
           value: e
         - key: exec-type
           value: local
   - name: Defaults
     engine: pig
     value: "a = LOAD 'src/test/resources/pig-tests/data.txt' USING PigStorage(',') AS (name:chararray, count:long);
             b = ORDER a BY count;
             validatar_results = LIMIT b 1;"
tests:
   - name: Simple Test
     description: Why I am testing this.
     asserts:
         - Query.name == "foo"
         - Query.count == 3
         - Defaults.name == "baz"
         - Defaults.count == -26
...
```

## src/test/resources/rest-tests/sample.yaml
```yaml
---
name: Rest test
description: Testing Validatar
queries:
   - name: Query1
     engine: rest
     value: "function read(input) {
                 var parsed = JSON.parse(input);
                 var result = {'users': [], 'counts': []};
                 for (var i = 0; i < parsed.length; i++) {
                     result['users'].push(parsed[i]['name']);
                     result['counts'].push(parsed[i]['count']);
                 }
                 return JSON.stringify(result);
             }"
     metadata:
         - key: url
           value: "http://localhost:13412/api/users"
         - key: method
           value: POST
         - key: body
           value: "{\"key\": \"value\"}"
         - key: rest-function
           value: read
   - name: Query2
     engine: rest
     value: "function process(input) {
                 return JSON.stringify({'max': [14]});
             }"
     metadata:
         - key: url
           value: "http://localhost:13412/api/visits/max"
         - key: rest-timeout
           value: 5000
         - key: rest-retry
           value: 3
   - name: Failer
     engine: rest
     value: ""
     metadata:
         - key: url
           value: "http://localhost:13412/api/users"
         - key: method
           value: PUT
tests:
   - name: Test1
     description: Why I am testing this.
     asserts:
         - Query1.users == "admin"
         - Query1.count > 10
   - name: Test2
     description: Why I am testing this.
     asserts:
         - Query2.count + Query1.count < 50
...
```
